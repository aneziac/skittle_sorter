#include <Arduino_KNN.h>

const int sample_count = 16;
const float calib_array[6][sample_count][3] = {
  {
    {213, 172, 293},
    {188, 142, 249},
    {205, 162, 279},
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    {237, 190, 326}
  },
  {
    {191, 146, 304},
    {177, 139, 268},
    {196, 157, 298},
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    {200, 162, 315}
  },
  {
    {190, 131, 218},
    {181, 119, 207},
    {179, 132, 223},
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    {208, 163, 270}
  },
  {
    {159, 126, 216},
    {148, 113, 197},
    {152, 125, 211},
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    {179, 154, 258}
  },
  {
    {281, 132, 242},
    {230, 123, 226},
    {250, 136, 245},
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    {257, 168, 290}
  },
  {
    {328, 156, 371},
    {218, 131, 264},
    {247, 143, 296},
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    {281, 175, 346}
  }
};

KNNClassifier color_KNN(3);

void read_calibration_data() {
  for (int i = 0; i < 5; i++) {
    for (int j = 0; j < sample_count; j++) {
      color_KNN.addExample(calib_array[i][j], i);
    }
    Serial.print("Calibrated "); Serial.println(i);
  }
  return;
}

void setup() {
    Serial.begin(9600);
    Serial.println("Starting...");
    read_calibration_data();    
    Serial.println("Complete");
    float color_vec[3] = {282, 222, 361};
    Serial.println(color_KNN.classify(color_vec, 6));
}

void loop() {
  while(1);
}
